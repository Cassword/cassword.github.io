//Libraries for wifi and website interaction
#include <ESP8266WiFi.h>
#include <ESP8266HTTPClient.h>
//--JSON reading library--
#include <ArduinoJson.h>
// -- Stuff necessary for OLED -------
#include <Streaming.h>
#include <iomanip>
#include <Adafruit_GFX.h>
#include <Adafruit_SSD1306.h>
// OLED i2c
#define OLED_RESET -1
#define OLED_SCREEN_I2C_ADDRESS 0x3C
Adafruit_SSD1306 display(OLED_RESET);
//--EXPANSION BOARD
#include <InvertedTM1638.h>
#include <TM1638.h>
#include <TM1638QYF.h>
#include <TM1640.h>
#include <TM16XX.h>
#include <TM16XXFonts.h>
#define TM1638_STB D5
#define TM1638_CLK D6
#define TM1638_DIO D7
TM1638 module(TM1638_DIO, TM1638_CLK, TM1638_STB);
//--Variables
byte buttons;               //setup buttons read
int httpCode;
String Dundee;
String Fort;
String PLOAD;
String thePayload;
unsigned long startMillis;      //some global variables available anywhere in the program
unsigned long currentMillis;
const unsigned long period = 30000;         //the value is a number of milliseconds, Set to 30 seconds for sustainability 
WiFiServer server(80);
int MyVal;
// WiFi connection system
const char* ssid = "YOURS HERE ";
const char* password = "HERE";
void setup() {
  Serial.begin(115200);
  WiFi.begin(ssid, password);
 
  while (WiFi.status() != WL_CONNECTED) {
    delay(1000);
    Serial.println("Connecting...");
  }
  Serial.println("Connected");

   display.begin(SSD1306_SWITCHCAPVCC, OLED_SCREEN_I2C_ADDRESS);      //turn on OLED
   startMillis = millis();        //start timer 
   server.begin();
   Serial.println("Server started");
}

void loop() {
   check();
  // Check WiFi Status
  buttons=module.getButtons();          // read which buttons are pressed
  if (WiFi.status() == WL_CONNECTED) {
    currentMillis = millis();           //get the current time (number of milliseconds since the program started)
    if (currentMillis - startMillis >= period){  
      HTTPClient http; 
      http.begin("http://api.openweathermap.org/data/2.5/weather?id=2650752&appid=693e1cf659fd7c760f031b67dc91cdb3");
      httpCode = http.GET();            //get data from above url
      Dundee = http.getString();        //transfer data to string
      http.begin("http://api.openweathermap.org/data/2.5/weather?id=2649169&appid=693e1cf659fd7c760f031b67dc91cdb3");
      httpCode = http.GET();            //get data from above url
      Fort = http.getString();          //transfer data to string
      startMillis = currentMillis;      //ensure that timer still works after one loop by essentially reseting the starting point
      Serial.print("CHECKED");
    }                                                          
    if (httpCode > 0) {
      if (PLOAD.length() == 0){         //set Dundee as default location, as when program initializes PLOAD hasn't been set yet so has no length. 
        PLOAD = Dundee;
      }

      thePayload = PLOAD;
      const char* payload = thePayload.c_str(); //convert string to const char
      const char* json = payload; //technically a pointless line, but makes it clearer in code. 
      
      // use of https://arduinojson.org/v6/assistant/ to convert API data to an easily enterable format. 
      DynamicJsonDocument doc(1024);
      deserializeJson(doc, json);
      float coord_lon = doc["coord"]["lon"]; // -5.11
      float coord_lat = doc["coord"]["lat"]; // 56.82
      
      JsonObject weather_0 = doc["weather"][0];
      int weather_0_id = weather_0["id"]; // 500
      const char* weather_0_main = weather_0["main"]; // "Rain"
      const char* weather_0_description = weather_0["description"]; // "light rain"
      const char* weather_0_icon = weather_0["icon"]; // "10d"
      
      const char* base = doc["base"]; // "stations"
      
      JsonObject main = doc["main"];
      float main_temp = main["temp"]; // 280.37
      Serial.println(main_temp);
      float main_feels_like = main["feels_like"]; // 279.15
      float main_temp_min = main["temp_min"]; // 280.37
      float main_temp_max = main["temp_max"]; // 280.37
      int main_pressure = main["pressure"]; // 998
      int main_humidity = main["humidity"]; // 97
      
      int visibility = doc["visibility"]; // 10000
      
      float wind_speed = doc["wind"]["speed"]; // 0.67
      int wind_deg = doc["wind"]["deg"]; // 247
      
      float rain_1h = doc["rain"]["1h"]; // 0.37
      
      int clouds_all = doc["clouds"]["all"]; // 100
      
      long dt = doc["dt"]; // 1607773774
      
      JsonObject sys = doc["sys"];
      int sys_type = sys["type"]; // 3
      long sys_id = sys["id"]; // 2010117
      const char* sys_country = sys["country"]; // "GB"
      long sys_sunrise = sys["sunrise"]; // 1607762929
      long sys_sunset = sys["sunset"]; // 1607787602
      
      int timezone = doc["timezone"]; // 0
      long id = doc["id"]; // 2649169
      const char* name = doc["name"]; // "Second Location - redacted for privacy"
      int cod = doc["cod"]; // 200
      Serial.println(name);
      String mystring(weather_0_main);
      float myFloat = main_temp - 273.15;    //Temp is given by default in Kelvin, so convert to C using maths. 
      float FTemp = myFloat*1.8 +32;        //Using same maths convert C to Farenheit
      int sensorValue = analogRead(A0);                     //Read in information from potentiometer
      Serial << sensorValue << endl;
      if (sensorValue <= 128){module.setupDisplay(true, 0);}            // if statement checks potentiometer and adjusts 7 Seg display module brightness.
      else if (sensorValue >128 and sensorValue <= 256){module.setupDisplay(true, 1);} // number adjacent to true is the brightness
      else if (sensorValue >256 and sensorValue <= 384){module.setupDisplay(true, 2);}
      else if (sensorValue >384 and sensorValue <= 512){module.setupDisplay(true, 3);}
      else if (sensorValue >512 and sensorValue <= 640){module.setupDisplay(true, 4);}
      else if (sensorValue >640 and sensorValue <= 768){module.setupDisplay(true, 5);}
      else if (sensorValue >768 and sensorValue <= 896){module.setupDisplay(true, 6);}
      else if (sensorValue >896 and sensorValue <= 1024){module.setupDisplay(true, 7);}

      
      if (buttons == 1|| MyVal == 1){                              //check expansion board buttons AND webserver values
         module.clearDisplay();                      //clear last thing on display, so that if pressed after another button it is the only thing displayed
         module.setDisplayToString(mystring,false); //display value in mystring 
         module.setLEDs(0x0001); //set no 1 to ON, using the Hex value
       }
       else if (buttons == 2 || MyVal == 2){
        module.clearDisplay();
        module.setDisplayToDecNumber(FTemp,0,false);
        module.setLEDs(0x0002);
       }
       else if (buttons == 4|| MyVal == 3){
        module.clearDisplay();
        module.setDisplayToDecNumber(myFloat,0,false);
        module.setLEDs(0x0004);
        
       }
       else if (buttons == 8 || MyVal == 4){
        module.setLEDs(0x0008);
        module.clearDisplay();
        module.setDisplayToString(name,false);
       }
       else if (buttons == 16){
        module.setLEDs(0x0010);
        module.clearDisplay();
        module.setDisplayToDecNumber(wind_speed,false);
        }
       else if (buttons == 32 || MyVal == 5){
        display.clearDisplay();
        display.display();
        module.setLEDs(0x0020);
       }
       else if(buttons == 64 || MyVal == 7){
        module.setLEDs(0x0040);
        char Location[] = "Set DUN";
        module.clearDisplay();
        module.setDisplayToString(Location,false);
        PLOAD = Dundee; //change location to Dundee
       }
       else if (buttons == 128 || MyVal == 8){
        module.setLEDs(0x0080);
        char Location[] = "Set FRT";
        module.clearDisplay();
        module.setDisplayToString(Location,false); 
        PLOAD = Fort; //change location to Second Location 
       }
      if (mystring == "Rain"){
        unsigned char myBitmap [] = { 
        0x00, 0x00, 0x03, 0xff, 0xff, 0xff, 0xff, 0xff, 0xff, 0xff, 0xff, 0xff, 0xff, 0xf0, 0x00, 0x00, 
        0x00, 0x00, 0x03, 0xff, 0xff, 0xff, 0xff, 0xff, 0xff, 0xff, 0xff, 0xff, 0xff, 0xe0, 0x00, 0x00, 
        0x00, 0x00, 0x00, 0xff, 0xff, 0xff, 0xff, 0xff, 0xff, 0xff, 0xff, 0xff, 0xff, 0x80, 0x00, 0x00, 
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        0x00, 0x00, 0x00, 0x00, 0x00, 0x00, 0x00, 0x00, 0x00, 0x00, 0x00, 0x00, 0x00, 0x00, 0x00, 0x00
      };
      display.clearDisplay();
      display.drawBitmap(0,0,myBitmap, 128,64,WHITE); //draw bitmap of size 128x64
      display.display();
      }
      else if (mystring == "Thunderstorm"){
        unsigned char myBitmap [] = {
          0x00, 0x00, 0x00, 0x00, 0x00, 0x00, 0x03, 0xfe, 0x00, 0x00, 0x00, 0x00, 0x00, 0x00, 0x00, 0x00, 
          0x00, 0x00, 0x00, 0x00, 0x00, 0x00, 0x0f, 0xbf, 0x00, 0x00, 0x00, 0x00, 0x00, 0x00, 0x00, 0x00, 
          0x00, 0x00, 0x00, 0x00, 0x00, 0x00, 0x1e, 0x07, 0x00, 0x00, 0x00, 0x00, 0x00, 0x00, 0x00, 0x00, 
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          0x00, 0x00, 0x00, 0x00, 0x00, 0x00, 0x00, 0x00, 0x00, 0x00, 0x00, 0x00, 0x00, 0x00, 0x00, 0x00
        };
        display.clearDisplay();
        display.drawBitmap(0,0,myBitmap, 128,64,WHITE);
        display.display();
      }
      else if (mystring == "Clear"){
        unsigned char myBitmap [] = {
          0xff, 0xff, 0xff, 0xff, 0xff, 0xff, 0xff, 0xff, 0xff, 0xff, 0xff, 0xff, 0xff, 0xff, 0xff, 0xff, 
          0xff, 0xfc, 0x07, 0xff, 0xf9, 0xff, 0x0f, 0xff, 0xff, 0xff, 0xff, 0xff, 0xff, 0xff, 0xff, 0xff, 
          0xff, 0xf8, 0x00, 0x7e, 0x03, 0xfc, 0x81, 0xff, 0xff, 0xff, 0xff, 0xff, 0xff, 0xff, 0xff, 0xff, 
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          0xff, 0xff, 0xff, 0xff, 0xff, 0xff, 0xff, 0xff, 0xff, 0xff, 0xff, 0xff, 0xff, 0xff, 0xff, 0xff
        };
        display.clearDisplay();
        display.drawBitmap(0,0,myBitmap, 128,64,WHITE);
        display.display();
      }        
      else if (mystring == "Snow"){
        unsigned char myBitmap [] = {
          0xff, 0xff, 0xff, 0xff, 0xff, 0xff, 0xff, 0xff, 0xff, 0xff, 0xff, 0xff, 0xff, 0xff, 0xff, 0xff, 
          0xff, 0xff, 0xff, 0xff, 0xff, 0xff, 0xff, 0xff, 0xff, 0xff, 0xff, 0xff, 0xff, 0xff, 0xff, 0xff, 
          0xff, 0xff, 0xff, 0xff, 0xff, 0xff, 0xff, 0xff, 0xff, 0xff, 0xff, 0xff, 0xff, 0xff, 0xff, 0xff, 
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          0xff, 0xff, 0xff, 0xff, 0xff, 0xff, 0xff, 0xff, 0xff, 0xff, 0xff, 0xff, 0xff, 0xff, 0xff, 0xff
        };
        display.clearDisplay();
        display.drawBitmap(0,0,myBitmap, 128,64,WHITE);
        display.display();
      }
      else if (mystring == "Drizzle"){        
        unsigned char myBitmap [] = {        //setup byte array image, used by converting an image to a 128x64 size and adjusting the colours by hand using https://javl.github.io/image2cpp/
          0x00, 0x00, 0x00, 0x00, 0x00, 0x00, 0x00, 0x00, 0x00, 0x00, 0x00, 0x00, 0x00, 0x00, 0x00, 0x00, 
          0x00, 0x00, 0x00, 0x00, 0x00, 0x00, 0x00, 0x00, 0x00, 0x00, 0x00, 0x00, 0x00, 0x00, 0x00, 0x00, 
          0x00, 0x00, 0x00, 0x00, 0x00, 0x00, 0x00, 0x00, 0x07, 0xf8, 0x00, 0x00, 0x00, 0x00, 0x00, 0x00, 
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          0xff, 0xff, 0xff, 0xff, 0xff, 0xff, 0xff, 0xff, 0xff, 0xff, 0xc0, 0x00, 0x00, 0x00, 0x00, 0x06
        };
        display.clearDisplay();
        display.drawBitmap(0,0,myBitmap, 128,64,WHITE);
        display.display();
      }
      else{ unsigned char myBitmap [] = {
        0x00, 0x00, 0x00, 0x00, 0x00, 0x00, 0x00, 0x00, 0x00, 0x00, 0x00, 0x00, 0x00, 0x00, 0x00, 0x00, 
        0x00, 0x00, 0x00, 0x00, 0x00, 0x00, 0x00, 0x1f, 0xe0, 0x00, 0x00, 0x00, 0x00, 0x00, 0x00, 0x00, 
        0x00, 0x00, 0x00, 0x00, 0x00, 0x00, 0x00, 0xff, 0xf8, 0x00, 0x00, 0x00, 0x00, 0x00, 0x00, 0x00, 
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        0x00, 0x00, 0x00, 0x00, 0x00, 0x00, 0x00, 0x00, 0x00, 0x00, 0x00, 0x00, 0x00, 0x00, 0x00, 0x00
        };
        display.clearDisplay();
        display.drawBitmap(0,0,myBitmap, 128,64,WHITE);
        display.display();
      }
    }
  }
}



void check(){
    WiFiClient client = server.available();
  if (!client) {
    return;
  }
  Serial.println("new client");
  String request = client.readStringUntil('\r'); //continue reading until end of line 
  Serial.println(request);




  // basically sending an entire html page as a response
  client.println("HTTP/1.1 200 OK");
  client.println("Content-Type: text/html");
  client.println("Refresh: 1");
  client.println("");
  client.println("<!DOCTYPE HTML>");
  client.println("<html>");
  client.println("<style>");
  client.println("input[type=button]{");
  client.println("margin: 0 auto;");
  client.println("width: auto;");
  client.println("height: auto;");
  client.println("};");
  client.println("a{");
  client.println("display: block");
  client.println("width: 200px;");
  client.println("height: 50px;");
  client.println("}");
  client.println("</style>");
  client.println("<br><br>");
  client.println("<form>");
  client.println("<a href=\"/Val=1\"><input type=\"button\" value=\"Weather\"></button></a>"); //changing a link on button click, we can then look at the link to check for the value. 
  client.println("<a href=\"/Val=2\"><input type=\"button\" value=\"F Temp\"></button></a>");
  client.println("<a href=\"/Val=3\"><input type=\"button\" value=\"C Temp\"></button></a>");
  client.println("<a href=\"/Val=4\"><input type=\"button\" value=\"Location\"></button></a>");
  client.println("<a href=\"/Val=5\"><input type=\"button\" value=\"Break\"></button></a>");
  client.println("<a href=\"/Val=7\"><input type=\"button\" value=\"Set Dundee\"></button></a>");
  client.println("<a href=\"/Val=8\"><input type=\"button\" value=\"Set Second Location\"></button></a>");
  client.println("</form>");
  client.println("</html>");
  if (request.indexOf("/Val=1") != -1) { //check if Val=1 exists in the string, if it does then set global variable MyVal = 1 
       MyVal = 1;
  }
  else if (request.indexOf("/Val=2") != -1) {
    MyVal = 2;
  }
  else if (request.indexOf("/Val=3") != -1) {
    MyVal = 3;
  }
  else if (request.indexOf("/Val=4") != -1) {
    MyVal = 4;
  }
  else if (request.indexOf("/Val=5") != -1) {
    MyVal = 5;
  }
  else if (request.indexOf("/Val=7") != -1) {
    MyVal = 7;
  }
  else if (request.indexOf("/Val=8") != -1) {
    MyVal = 8;
  }
}
